## Kconfig
```kconfig
config ZMK_KEY_LAYER_DEFER
    bool "Defer regular key dispatch for layer detection"
    default n
    help
      Captures every position-press that is not a configured modifier key
      and delays forwarding it for up to ZMK_KEY_LAYER_DEFER_MS.  This
      gives &mo and hold-tap layer activations time to register before the
      key binding is resolved against the layer stack.

      Only one regular key is held at a time.  A second regular key
      flushes the first.  A modifier key also flushes the held key first,
      then passes through immediately.

      IMPORTANT: All combo timeout-ms values must be strictly greater than
      ZMK_KEY_LAYER_DEFER_MS, because this module delays events before
      combo.c sees them, consuming part of the combo's timing window.

if ZMK_KEY_LAYER_DEFER

config ZMK_KEY_LAYER_DEFER_MS
    int "Layer detection window (ms)"
    default 50
    help
      How long to hold a regular key press before forwarding it.

config ZMK_KEY_LAYER_DEFER_MOD_POSITIONS
    string "Space-separated key positions treated as modifier/layer keys"
    default ""
    help
      Physical key position numbers that pass through immediately without
      deferral.  Include all keys bound to &mo, &lt, &mt, &sk, etc.
      These are the same position indices used in combo key-positions.
      Example: "30 31 32 33 34 35"

endif # ZMK_KEY_LAYER_DEFER
```

## config/boards/shields/comfykey/Kconfig.defconfig
```kconfig
if SHIELD_COMFYKEY_DONGLE

config ZMK_KEYBOARD_NAME
    default "Comfykey"

config ZMK_SPLIT_ROLE_CENTRAL
    default y

endif

if SHIELD_COMFYKEY_LEFT || SHIELD_COMFYKEY_RIGHT || SHIELD_COMFYKEY_DONGLE

config ZMK_SPLIT
    default y

endif
```

## config/boards/shields/comfykey/Kconfig.shield
```kconfig
# Copyright (c) 2026 Frederick Altrock
# SPDX-License-Identifier: MIT

config SHIELD_COMFYKEY_LEFT
    def_bool $(shields_list_contains,comfykey_left)

config SHIELD_COMFYKEY_RIGHT
    def_bool $(shields_list_contains,comfykey_right)

config SHIELD_COMFYKEY_DONGLE
    def_bool $(shields_list_contains,comfykey_dongle)
```

## config/west.yml
```yaml
manifest:
  defaults:
    revision: v0.3
  remotes:
    - name: zmkfirmware
      url-base: https://github.com/zmkfirmware
    # Additional modules containing boards/shields/custom code can be listed here as well
    # See https://docs.zephyrproject.org/3.2.0/develop/west/manifest.html#projects
    - name: englmaxi
      url-base: https://github.com/englmaxi
    - name: FrederickAlt
      url-base: https://github.com/FrederickAlt
  projects:
    - name: zmk
      remote: zmkfirmware
      import: app/west.yml
    - name: zmk-dongle-display
      remote: englmaxi
    - name: zmk-feature-simultaneous_modifiers
      remote: FrederickAlt
      revision: main
  self:
    path: config
```
